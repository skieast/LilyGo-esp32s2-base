## main/Kconfig.projbuild
```kconfig
menu "Example Configuration"

    config SCAN_LIST_SIZE
        int "Max size of scan list"
        range 0 30
        default 20
        help
            The size of array that will be used to retrieve the list of access points.

endmenu
```
